## target/linux/ramips/files/drivers/net/ethernet/mtk/Kconfig
```kconfig
# SPDX-License-Identifier: GPL-2.0-only
config NET_VENDOR_RAW_MEDIATEK
	bool "MediaTek ethernet driver"
	depends on ARCH_MEDIATEK || SOC_MT7621 || SOC_MT7620
	help
	  If you have a Mediatek SoC with ethernet, say Y.

if NET_VENDOR_RAW_MEDIATEK

config NET_MEDIATEK_SOC_GE
	tristate "MediaTek SoC Gigabit Ethernet support"
	select PHYLINK
	select DIMLIB
	help
	  This driver supports the gigabit ethernet MACs in the
	  MediaTek SoC family.

config MEDIATEK_NETSYS_V2
	tristate "MediaTek Ethernet NETSYS V2 support"
	 depends on ARCH_MEDIATEK && NET_MEDIATEK_SOC_GE
	help
	  This options enable MTK Ethernet NETSYS V2 support

config MEDIATEK_NETSYS_V3
	tristate "MediaTek Ethernet NETSYS V3 support"
	help
	  This options enable MTK Ethernet NETSYS V3 support

config NET_MEDIATEK_HNAT
	tristate "MediaTek HW NAT support"
	depends on NET_MEDIATEK_SOC_GE && NF_CONNTRACK && IP_NF_NAT
	help
	  This driver supports the hardward Network Address Translation
	  in the MediaTek MT2701/MT7622/MT7629/MT7621 chipset family.
	  
config ARCH_MT7622_WIFI_HW_NAT
	tristate "ARCH_MT7622_WIFI_HW_NAT"
	bool
	default n
	  
config RA_HW_NAT
	tristate "RA_HW_NAT"
	help
	  This driver supports RA_HW_NAT
	  
config RA_HW_NAT_PPTP_L2TP
	tristate "RA_HW_NAT_PPTP_L2TP"
	help
	  This driver supports RA_HW_NAT_PPTP_L2TP
	  
config NET_MEDIATEK_HW_QOS
	bool "Mediatek HW QoS support"
	depends on NET_MEDIATEK_HNAT
	default n

endif #NET_VENDOR_RAW_MEDIATEK
```
